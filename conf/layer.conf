## conf/layer.conf
```bitbake
# We have a conf directory, append to BBPATH
BBPATH .= ":${LAYERDIR}"

# We have a recipes directory, add to BBFILES
BBFILES += "${LAYERDIR}/recipes*/*.bb ${LAYERDIR}/recipes*/*/*.bb ${LAYERDIR}/recipes*/*/*.bbappend"

BBFILE_COLLECTIONS += "meta-misc"
BBFILE_PATTERN_meta-misc := "^${LAYERDIR}/"
BBFILE_PRIORITY_meta-misc = "10"
LAYERSERIES_COMPAT_meta-misc = "sumo thud"
```
